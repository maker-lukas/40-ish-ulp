## firmware/source/boards/shields/ulp/Kconfig.defconfig
```kconfig
if SHIELD_ULP_LEFT

config ZMK_KEYBOARD_NAME
    default "40ish ulp"

config ZMK_SPLIT_ROLE_CENTRAL
    default y

endif # SHIELD_ULP_LEFT

if SHIELD_ULP_LEFT || SHIELD_ULP_RIGHT

config ZMK_SPLIT
    default y

endif # SHIELD_ULP_LEFT || SHIELD_ULP_RIGHT
```

## firmware/source/boards/shields/ulp/Kconfig.shield
```kconfig
config SHIELD_ULP_LEFT
    def_bool $(shields_list_contains,ulp_left)

config SHIELD_ULP_RIGHT
    def_bool $(shields_list_contains,ulp_right)
```
